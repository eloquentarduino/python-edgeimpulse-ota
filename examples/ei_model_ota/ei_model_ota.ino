/**
 * Edge Impulse OTA updates.
 * Open the Serial Monitor and enter "ota"
 * to perform the update.
 * Enter "restore" to restore the original weights.
 *
 * This project ships with a "dumb" model (default)
 * which can't predict anything. When you enter "ota",
 * a "smart" model is loaded and you will see it detects
 * the penguin in the input data.
 *
 * When you enter "restore", the dumb model is loaded back
 * and the models makes no more predictions.
 */

//#define EI_OTA_SWAP_BYTES


#include <fomo-dumb-ota.h>
#include "./models.h"
#include "./BytesIO.h"


signal_t input;
ei_impulse_result_t result;
BytesIO smartPatch(smart, sizeof(smart));

float penguin[] = {0x4c584d, 0x4c5750, 0x4f5a58, 0x505b5e, 0x525d58, 0x535f54, 0x546157, 0x556258, 0x546457, 0x546756, 0x546555, 0x516454, 0x536455,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 0x90f0d, 0x90f0d};


void updateWeights(BytesIO& patch);
void restoreWeights();


void setup() {
  Serial.begin(115200);
  while (!Serial);
  delay(3000);
  Serial.println("Run Edge Impulse Object Detection");

  //input.total_length = EI_CLASSIFIER_RAW_SAMPLE_COUNT;
}


void loop() {
  Serial.println("loop");
  String userInput = Serial.available() ? Serial.readStringUntil('\n') : "";


  // update / restore weights from user input
  if (userInput.startsWith("ota")) {
    smartPatch.seek(0);
    updateWeights(smartPatch);
  }

  if (userInput.startsWith("restore")) {
    restoreWeights();
  }


  // run impulse
  if (numpy::signal_from_buffer(penguin, EI_CLASSIFIER_DSP_INPUT_FRAME_SIZE, &input) != 0) {
    Serial.println("numpy::signal_from_buffer failed");
    return;
  }

  if (run_classifier(&input, &result, false) != 0) {
    Serial.println("run_classifier failed");
    return;
  }


  // print results
  for (size_t ix = 0; ix < result.bounding_boxes_count; ix++) {
    auto bb = result.bounding_boxes[ix];

    if (bb.value > 0) {
        Serial.print(" > Found object ");
        Serial.print(bb.label);
        Serial.print(" at x, y = ");
        Serial.print(bb.x);
        Serial.print(", ");
        Serial.print(bb.y);
        Serial.print(" with confidence ");
        Serial.println(bb.value);
    }
  }

  delay(1000);
}


void updateWeights(BytesIO& patch) {
  Serial.println("Updating weights...");
  String updateError = ei_ota(patch);

  if (updateError != "") {
    Serial.print("Update error: ");
    Serial.println(updateError);
    restoreWeights();
  }
  else {
    Serial.println("Update ok!");
  }
}


void restoreWeights() {
  Serial.println("Restoring original weights...");

  String restoreError = ei_restore();

  if (restoreError != "") {
    Serial.print("Restore error: ");
    Serial.println(restoreError);
  }
  else {
    Serial.println("Restore ok!");
  }
}
